## conf/layer.conf
```bitbake
BBPATH .= ":${LAYERDIR}"

BBFILES += "${LAYERDIR}/recipes-*/*/*.bb \
            ${LAYERDIR}/recipes-*/*/*.bbappend"

BBFILE_COLLECTIONS += "rpi-managed-switch-bsp"
BBFILE_PATTERN_rpi-managed-switch-bsp = "^${LAYERDIR}/"
# Above meta-raspberrypi (9), which this layer builds on.
BBFILE_PRIORITY_rpi-managed-switch-bsp = "10"

LAYERDEPENDS_rpi-managed-switch-bsp = "core raspberrypi"
LAYERSERIES_COMPAT_rpi-managed-switch-bsp = "wrynose"
```
